## boards/shields/forager/Kconfig.defconfig
```kconfig
if SHIELD_FORAGER_LEFT

config ZMK_KEYBOARD_NAME
    default "Forager"

config ZMK_SPLIT_ROLE_CENTRAL
    default y

config ZMK_STUDIO
    default y

# Report the right half's battery to the host too
config ZMK_SPLIT_BLE_CENTRAL_BATTERY_LEVEL_PROXY
    default y

choice RGBLED_WIDGET_BATTERY_SHOW
    default RGBLED_WIDGET_BATTERY_SHOW_PERIPHERALS
endchoice

endif

if SHIELD_FORAGER_LEFT || SHIELD_FORAGER_RIGHT

config ZMK_SPLIT
    default y

endif
```
